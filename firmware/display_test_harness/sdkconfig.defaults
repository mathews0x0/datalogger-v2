## firmware_p4/firmware/main/Kconfig.projbuild
```kconfig
menu "RaceSense Configuration"

    choice RS_DISPLAY_PROFILE
        prompt "RaceSense display profile"
        default RS_DISPLAY_PROFILE_800_480 if IDF_TARGET_ESP32P4
        default RS_DISPLAY_PROFILE_320_240
        help
            Select the logical UI resolution independently from the ESP target.
            Board support packages own controller, touch, and pin translations;
            the shared UI only consumes this profile.

        config RS_DISPLAY_PROFILE_320_240
            bool "320x240 (2.8 inch compact)"

        config RS_DISPLAY_PROFILE_480_320
            bool "480x320 (3.5 inch medium)"

        config RS_DISPLAY_PROFILE_800_480
            bool "800x480 (4.3 inch widescreen)"
    endchoice

    config RS_IMU_SAMPLE_RATE_HZ
        int "IMU sampling rate in Hz"
        default 100
        help
            BMI323 accelerometer and gyroscope sampling frequency.

    config RS_GPS_RATE_HZ
        int "GPS measurement rate in Hz"
        default 10
        help
            Neo-M8N GNSS measurement rate configured via UBX CFG-RATE.

    config RS_GPS_BAUD
        int "GPS UART baud rate"
        default 38400
        help
            Target baud rate for Neo-M8N UART after UBX CFG-PRT init.

    config RS_AUTO_LOG_DELAY_MS
        int "Auto-log countdown delay in ms"
        default 10000
        help
            Time after GPS lock before auto-logging starts (if enabled).

    config RS_STORAGE_CRITICAL_PCT
        int "Storage critical threshold percentage"
        default 90
        help
            Percentage of SD card usage that triggers STORAGE_CRITICAL state.

    config RS_STORAGE_HARD_STOP_PCT
        int "Storage hard stop threshold percentage"
        default 98
        help
            Percentage of SD card usage that triggers HARD_STOP (no more writes).

    config RS_SECTOR_FLASH_DURATION_MS
        int "Sector crossing flash overlay duration in ms"
        default 3000
        help
            Duration the sector crossing color flash overlays the logging screen.

endmenu
```

## firmware_p4/firmware/sdkconfig.defaults.esp32s3
```kconfig
# ============================================================
# RaceSense ESP32-S3 Default SDK Configuration
# Target: RaceSense RS-Core V4.2 PCB (ESP32-S3-WROOM-1-N16R8)
# ============================================================

CONFIG_IDF_TARGET="esp32s3"

# --- Flash (16MB Flash) ---
CONFIG_ESPTOOLPY_FLASHSIZE_16MB=y
CONFIG_ESPTOOLPY_FLASHMODE_QIO=y
CONFIG_ESPTOOLPY_FLASHFREQ_80M=y

# --- PSRAM (8MB Octal PSRAM) ---
CONFIG_SPIRAM=y
CONFIG_SPIRAM_MODE_OCT=y
CONFIG_SPIRAM_SPEED_80M=y
CONFIG_SPIRAM_BOOT_INIT=y
CONFIG_SPIRAM_ALLOW_STACK_EXTERNAL_MEMORY=y

# --- Native Wi-Fi ---
CONFIG_ESP_WIFI_ENABLED=y
CONFIG_ESP_WIFI_STATIC_RX_BUFFER_NUM=10
CONFIG_ESP_WIFI_DYNAMIC_RX_BUFFER_NUM=32
CONFIG_ESP_WIFI_TX_BUFFER_TYPE=1
CONFIG_ESP_WIFI_DYNAMIC_RX_MGMT_BUF=y
CONFIG_ESP_WIFI_CACHE_TX_BUFFER_NUM=16
CONFIG_ESP_WIFI_ESPNOW_MAX_ENCRYPT_NUM=7

# --- LVGL Display ---
CONFIG_LV_COLOR_16_SWAP=y
```
